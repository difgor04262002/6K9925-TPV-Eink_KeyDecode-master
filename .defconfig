## target/configs/6K9925_ASUS_ControlBOX_NAND_defconfig
```kconfig
CONFIG_PRJ_DEFCONFIG_FILENAME="6K9925_ASUS_ControlBOX_NAND_defconfig"
CONFIG_PRJ_CHIP="d12p"
CONFIG_PRJ_BOARD="demo88-nor"
CONFIG_PRJ_KERNEL="rt-thread"
CONFIG_PRJ_APP="helloworld"
CONFIG_AIC_USING_FS_IMAGE_0=y
CONFIG_AIC_USING_FS_IMAGE_TYPE_FATFS_FOR_0=y
CONFIG_AIC_FS_IMAGE_DIR_0="rodata"
CONFIG_AIC_FS_IMAGE_NAME_0="rodata.fatfs"
CONFIG_AIC_USING_FS_IMAGE_1=y
CONFIG_AIC_USING_FS_IMAGE_TYPE_FATFS_FOR_1=y
CONFIG_AIC_FS_IMAGE_DIR_1="target/d12p/demo88-nor/pack/data"
CONFIG_AIC_FS_IMAGE_NAME_1="data.fatfs"
CONFIG_LVGL_V_9=y
CONFIG_LPKG_LVGL_THREAD_STACK_SIZE=49152
CONFIG_AIC_LVGL_DEMO=y
CONFIG_AIC_LVGL_UI_BUILDER=y
CONFIG_LV_CACHE_IMG_NUM=8
CONFIG_LV_CACHE_DEF_SIZE=0x200000
CONFIG_MPP_JPEG_DEC_OUT_SIZE_LIMIT_ENABLE=y
CONFIG_MPP_JPEG_DEC_MAX_OUT_WIDTH=1024
CONFIG_MPP_JPEG_DEC_MAX_OUT_HEIGHT=600
CONFIG_LV_USE_SPI_REPLACE_MIPI_DBI=y
CONFIG_LV_SPI_ST77916=y
CONFIG_LV_SPI_BUS_WIDTH_4=y
CONFIG_AIC_USING_UART0=y
CONFIG_AIC_USING_I2C1=y
CONFIG_AIC_USING_USB0=y
CONFIG_AIC_USING_QSPI0=y
CONFIG_AIC_DEV_QSPI0_MAX_SRC_FREQ_HZ=200000000
CONFIG_AIC_USING_QSPI1=y
CONFIG_AIC_DEV_QSPI1_MAX_SRC_FREQ_HZ=200000000
CONFIG_AIC_USING_QSPI3=y
CONFIG_AIC_DEV_QSPI3_MAX_SRC_FREQ_HZ=200000000
CONFIG_AIC_QSPI3_BUS_WIDTH_1=y
CONFIG_AIC_QSPI3_BUS_WIDTH=1
CONFIG_AIC_DEV_QSPI3_DELAY_MODE=2
CONFIG_AIC_QSPI3_DYNAMIC_DMA=y
CONFIG_AIC_QSPI3_BUS_SPI=y
# CONFIG_AIC_QSPI0_DEVICE_SPINOR is not set
CONFIG_AIC_QSPI0_DEVICE_SPINAND=y
CONFIG_AIC_QSPI0_DEVICE_SPINAND_FREQ=50000000
CONFIG_SPI_NAND_WINBOND=y
# CONFIG_AIC_USING_SDMC1 is not set
CONFIG_AIC_USING_TSEN=y
CONFIG_AIC_USING_TSEN_CPU=y
CONFIG_AIC_DISP_MIPI_DBI=y
CONFIG_AICFB_RGB565=y
# CONFIG_AIC_DISP_BOOTUP_LOGO is not set
CONFIG_AIC_PANEL_DBI_ZC_T1D8BP=y
CONFIG_AIC_PANEL_ENABLE_GPIO="PF.0"
CONFIG_AIC_GE_CMDQ=y
CONFIG_AIC_USING_DMA=y
CONFIG_AIC_USING_WRI=y
CONFIG_AIC_USING_RTC=y
CONFIG_AIC_USING_WDT=y
CONFIG_AIC_PSRAM_SIZE=0x1000000
CONFIG_AIC_PSRAM_SW_SIZE=0x200000
CONFIG_AIC_INTERRUPTSTACK_SIZE=4096
CONFIG_AIC_USING_SID=y
CONFIG_AIC_SYSCFG_LDO1X_ENABLE=y
CONFIG_RT_NAME_MAX=8
CONFIG_IDLE_THREAD_STACK_SIZE=1024
# CONFIG_RT_USING_TIMER_SOFT is not set
# CONFIG_RT_KSERVICE_USING_STDLIB is not set
# CONFIG_RT_DEBUG is not set
CONFIG_RT_MEMHEAP_BSET_MODE=y
CONFIG_RT_USING_MEMHEAP_AS_HEAP=y
# CONFIG_RT_USING_MEMHEAP_AUTO_BINDING is not set
CONFIG_RT_USING_MEMTRACE=y
CONFIG_RT_CONSOLE_DEVICE_NAME="uart0"
CONFIG_RT_MAIN_THREAD_STACK_SIZE=8192
CONFIG_RT_USING_LEGACY=y
CONFIG_FINSH_HISTORY_LINES=1
CONFIG_DFS_FILESYSTEMS_MAX=8
CONFIG_RT_USING_DFS_MNTTABLE=y
CONFIG_RT_USING_DFS_ELMFAT=y
CONFIG_RT_DFS_ELM_LFN_UNICODE_2=y
CONFIG_RT_DFS_ELM_USE_EXFAT=y
CONFIG_RT_DFS_ELM_DRIVES=4
CONFIG_RT_DFS_ELM_MAX_SECTOR_SIZE=4096
CONFIG_RT_USING_DFS_ROMFS=y
# CONFIG_RT_USING_FAL is not set
CONFIG_RT_USING_ADC=y
CONFIG_RT_USING_SDIO=y
CONFIG_RT_MMCSD_STACK_SIZE=8192
# CONFIG_RT_SFUD_USING_QSPI is not set
CONFIG_RT_USING_TOUCH=y
CONFIG_RT_TOUCH_PIN_IRQ=y
CONFIG_RT_USING_POSIX_FS=y
CONFIG_RT_USING_ULOG=y
CONFIG_ULOG_OUTPUT_LVL_I=y
CONFIG_ULOG_TIME_USING_TIMESTAMP=y
CONFIG_LPKG_USING_CPU_USAGE=y
CONFIG_LPKG_USING_CHERRYUSB=y
CONFIG_LPKG_CHERRYUSB_DEVICE=y
CONFIG_LPKG_CHERRYUSB_DEVICE_COMPOSITE=y
CONFIG_LPKG_CHERRYUSB_DEVICE_COMPOSITE_SERIALNUMBER=y
CONFIG_LPKG_USING_COMP_VENDER_TABLE1=y
CONFIG_LPKG_USING_COMP_VENDER_TABLE2=y
CONFIG_LPKG_USING_COMP_DISP_TABLE2=y
CONFIG_LPKG_CHERRYUSB_DYNAMIC_REGISTRATION_MODE=y
CONFIG_AIC_NFTL_SUPPORT=y
CONFIG_AIC_NFLT_USED_LIB=y
CONFIG_LPKG_USING_I2C_TOOLS=y
CONFIG_LPKG_USING_MHZ=y
CONFIG_AIC_MPP_PLAYER_INTERFACE=y
CONFIG_AIC_MPP_VE_TEST=y
CONFIG_AIC_MPP_AICP_DEC_ENABLE=y
CONFIG_AIC_ENV_INTERFACE=y
# CONFIG_AIC_AB_SYSTEM_INTERFACE is not set
CONFIG_LPKG_USING_PINMUX_CHECHK=y
CONFIG_AIC_PINMUX_CHECK=y
CONFIG_LPKG_USING_AIC_SPIENC_AUTHORIZATION=y
CONFIG_AIC_GPIO_IRQ_DRV_EN=y
CONFIG_AIC_USING_TOUCH=y
CONFIG_AIC_TOUCH_PANEL_I2C_CHAN="i2c1"
CONFIG_AIC_TOUCH_PANEL_RST_PIN="PD.0"
CONFIG_AIC_TOUCH_PANEL_INT_PIN="PD.1"
CONFIG_AIC_I2S_CODEC_SELECT=y
# CONFIG_AIC_I2S_CODEC_TLV320 is not set
CONFIG_AIC_I2S_CODEC_JY6311=y
CONFIG_AIC_I2S_CODEC_JY6311_I2C="i2c1"
CONFIG_AIC_I2S_CODEC_PA_PIN="PE.17"
CONFIG_AIC_CMU_DRV_TEST=y
CONFIG_AIC_QSPI_LCD_ST77916=y
CONFIG_AIC_TP_DRV_TEST=y
CONFIG_AIC_WDT_DRV_TEST=y
```

## target/configs/d12p_demo88-nor_baremetal_bootloader_nand_defconfig
```kconfig
CONFIG_PRJ_DEFCONFIG_FILENAME="d12p_demo88-nor_baremetal_bootloader_nand_defconfig"
CONFIG_PRJ_CHIP="d12p"
CONFIG_PRJ_BOARD="demo88-nor"
CONFIG_PRJ_KERNEL="baremetal"
CONFIG_PRJ_APP="bootloader"
CONFIG_PRJ_CUSTOM_LDS="application/baremetal/bootloader/ldscript/d12p_bootloader_gcc.ld"
CONFIG_AIC_USING_UART0=y
CONFIG_AIC_USING_QSPI0=y
CONFIG_AIC_DEV_QSPI0_MAX_SRC_FREQ_HZ=200000000
# CONFIG_AIC_QSPI0_DEVICE_SPINOR is not set
CONFIG_AIC_QSPI0_DEVICE_SPINAND=y
CONFIG_AIC_QSPI0_DEVICE_SPINAND_FREQ=50000000
CONFIG_SPI_NAND_WINBOND=y
# CONFIG_AIC_USING_GE is not set
# CONFIG_AIC_USING_VE is not set
# CONFIG_AIC_USING_DE is not set
# CONFIG_AIC_USING_SDMC1 is not set
CONFIG_AIC_USING_DMA=y
CONFIG_AIC_USING_WRI=y
CONFIG_AIC_USING_RTC=y
CONFIG_AIC_USING_WDT=y
CONFIG_AIC_PSRAM_SW_SIZE=0x300000
CONFIG_AIC_INTERRUPTSTACK_SIZE=8192
CONFIG_AIC_USING_SID=y
CONFIG_EFUSE_WRITE_SUPPORT=y
CONFIG_AIC_SYSCFG_LDO1X_ENABLE=y
CONFIG_AIC_NORMALSTACK_SIZE=8192
CONFIG_AIC_BOOTLOADER_TEXT_SIZE=0x7FF00
# CONFIG_AIC_BOOTLOADER_SPINOR_SUPPORT is not set
# CONFIG_AICUPG_SUPPORT is not set
CONFIG_AIC_BOOTLOADER_CMD_NAND_BOOT=y
CONFIG_AIC_BOOTLOADER_CMD_MTD=y
CONFIG_LPKG_USING_FDTLIB=y
CONFIG_LPKG_USING_FDTLIB_CRC32_VERIFY=y
CONFIG_AIC_ENV_INTERFACE=y
# CONFIG_AIC_AB_SYSTEM_INTERFACE is not set
CONFIG_AIC_LOG_LEVEL_INFO=y
# CONFIG_LPKG_MPP is not set
# CONFIG_AIC_NFTL_SUPPORT is not set
```
